## examples/lvgl/main/Kconfig.projbuild
```kconfig
menu "Pin Configuration"
    menu "SPI Pins"
        # SPI pin mapping is only configurable on the ESP32-S3
        visible if IDF_TARGET_ESP32S3
        config SPI_MISO
            int "MISO pin"
            default 2 if IDF_TARGET_ESP32
            default 13 if IDF_TARGET_ESP32S3
            range 0 48 if IDF_TARGET_ESP32S3
        config SPI_MOSI
            int "MOSI pin"
            default 15 if IDF_TARGET_ESP32
            default 10 if IDF_TARGET_ESP32S3
            range 0 48 if IDF_TARGET_ESP32S3
        config SPI_CLOCK
            int "Clock pin"
            default 14 if IDF_TARGET_ESP32
            default 11 if IDF_TARGET_ESP32S3
            range 0 48 if IDF_TARGET_ESP32S3
    endmenu

    menu "TFT Pins"
        config TFT_CS_PIN
            int
            range -1 33 if IDF_TARGET_ESP32
            range -1 48 if IDF_TARGET_ESP32S3
            default 3 if IDF_TARGET_ESP32S3
            default 16

        config TFT_RESET_PIN
            int
            range -1 33 if IDF_TARGET_ESP32
            range -1 48 if IDF_TARGET_ESP32S3
            default 46 if IDF_TARGET_ESP32S3
            default -1
    
        config TFT_DC_PIN
            int
            range -1 33 if IDF_TARGET_ESP32
            range -1 48 if IDF_TARGET_ESP32S3
            default 9 if IDF_TARGET_ESP32S3
            default 17

        config TFT_BACKLIGHT_PIN
            int
            range -1 33 if IDF_TARGET_ESP32
            range -1 48 if IDF_TARGET_ESP32S3
            default 12 if IDF_TARGET_ESP32S3
            default 18
    endmenu
endmenu

choice DISPLAY_COLOR_MODE
    bool "Color Mode"
    default DISPLAY_COLOR_MODE_BGR
    config DISPLAY_COLOR_MODE_BGR
        bool "Blue,Green,Red"
    config DISPLAY_COLOR_MODE_RGB
        bool "Red,Green,Blue"
endchoice

config DISPLAY_COLOR_MODE
    int
    default 1 if DISPLAY_COLOR_MODE_BGR
    default 0 if DISPLAY_COLOR_MODE_RGB
```

## examples/lvgl/sdkconfig.defaults
```kconfig
# ILI9488 uses 18 bit color mode and requires 16bit LVGL color depth.
CONFIG_LV_COLOR_DEPTH_16=y
```
